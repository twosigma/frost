## linux/frost-memerr/Kconfig
```kconfig
# SPDX-License-Identifier: GPL-2.0-only OR BSD-2-Clause
#
# FROST memory error unit configuration
#

config FROST_MEMERR
	tristate "FROST memory error unit"
	depends on OF && HAS_IOMEM && 64BIT
	help
	  Driver for the memory error unit of the FROST SoC, which counts
	  the DDR controller's corrected and uncorrectable ECC errors and
	  the error responses DDR returns to the cache hierarchy. The
	  driver logs each report, scrubs corrected lines with atomic
	  writes, patrols RAM in the background, and shows counters in sysfs.

	  To compile this driver as a module, choose M here. The module
	  will be called frost_memerr.
```

## linux/frost-net10g/Kconfig
```kconfig
# SPDX-License-Identifier: GPL-2.0-only OR BSD-2-Clause
#
# FROST network device configuration
#

config NET_VENDOR_FROST
	bool "FROST devices"
	default y
	help
	  If you have a network device belonging to the FROST RISC-V SoC,
	  say Y.

	  Note that the answer to this question doesn't directly affect the
	  kernel: saying N will just cause the configurator to skip all
	  the questions about FROST devices.

if NET_VENDOR_FROST

config FROST_NET10G
	tristate "FROST net10g 10GBASE-R Ethernet"
	depends on OF && HAS_IOMEM && HAS_DMA
	help
	  Driver for the 10GBASE-R Ethernet controller of the FROST SoC: a
	  soft MAC/PCS with RX and TX descriptor rings in system memory
	  and one interrupt.

	  To compile this driver as a module, choose M here. The module
	  will be called frost_net10g.

endif # NET_VENDOR_FROST
```

## sw/uboot/configs/frost_vcu118_defconfig
```kconfig
CONFIG_RISCV=y
CONFIG_TARGET_QEMU_VIRT=y
CONFIG_ARCH_RV64I=y
CONFIG_RISCV_ISA_C=y
CONFIG_RISCV_SMODE=y
CONFIG_CMODEL_MEDANY=y

CONFIG_TEXT_BASE=0x80200000
CONFIG_SYS_MALLOC_LEN=0x800000
CONFIG_SYS_MALLOC_F_LEN=0x4000
CONFIG_NR_DRAM_BANKS=1
CONFIG_HAS_CUSTOM_SYS_INIT_SP_ADDR=y
CONFIG_CUSTOM_SYS_INIT_SP_ADDR=0x80400000
CONFIG_SYS_LOAD_ADDR=0x84000000
CONFIG_ENV_SIZE=0x20000

# Device Tree passed from OpenSBI in a1
CONFIG_OF_CONTROL=y
CONFIG_OF_BOARD=y
CONFIG_DEFAULT_DEVICE_TREE="qemu-virt64"
# CONFIG_BOARD_INIT is not set

# Serial Console (ns16550a @ 0x40001000)
CONFIG_DM_SERIAL=y
CONFIG_SYS_NS16550=y
CONFIG_BAUDRATE=115200

# RISC-V architectural timer
CONFIG_TIMER=y
CONFIG_RISCV_TIMER=y

# Disable parallel NOR CFI flash (VCU118 uses SPI NOR flash MT25QU01G)
# CONFIG_MTD_NOR_FLASH is not set
# CONFIG_CFI_FLASH is not set
# CONFIG_CMD_FLASH is not set

# FROST Ethernet NIC (coherent DMA @ 0x40022000)
CONFIG_NET=y
CONFIG_FROST_NET10G=y
CONFIG_CMD_NET=y
CONFIG_CMD_DHCP=y
CONFIG_CMD_PING=y
CONFIG_CMD_TFTPBOOT=y

# Command Line & Boot Environment
CONFIG_SYS_PROMPT="frost=> "
CONFIG_CMD_BOOTM=y
CONFIG_CMD_BOOTI=y
CONFIG_LEGACY_IMAGE_FORMAT=y
CONFIG_SUPPORT_RAW_INITRD=y
CONFIG_CMD_MEMTEST=y
CONFIG_CMD_MEMORY=y
CONFIG_CMD_RUN=y
CONFIG_HUSH_PARSER=y
CONFIG_BOOTDELAY=3

# Interactive prompt; boot commands use the selected local or network images.

# SPI and SPI NOR Flash
CONFIG_SPI=y
CONFIG_DM_SPI=y
CONFIG_DM_SPI_FLASH=y
CONFIG_SPI_FLASH=y
CONFIG_SPI_FLASH_STMICRO=y
# CONFIG_SPI_FLASH_BAR is not set
CONFIG_CMD_SF=y
CONFIG_FROST_SPI=y

# CONFIG_TOOLS_MKEFICAPSULE is not set
# CONFIG_USE_BOOTCOMMAND is not set
CONFIG_ENV_IS_NOWHERE=y
```
